## drivers/misc/mediatek/Kconfig.power
```kconfig
#
# All config related to power(PMIC/Battery/Charger...) goes here.
#

menu "Power Related Drivers (PMIC/Battery/Charger)"

# Power Related
if POWER_SUPPLY
config MT6326_PMIC # PMIC_MT6326
	tristate "MediaTek PMIC Driver"
	depends on ARCH_MT6516
	default y

config MTK_SMART_BATTERY #
	tristate "MediaTek Smart Battery Driver"
	default y

config MTK_DUMMY_BATTERY # DUMMY_BATTERY_MT6516
	tristate "MediaTek Dummy Battery Driver"
	depends on ARCH_MT6516
	default n

config MTK_PMU # PMU_MT6573
	tristate "MediaTek Power Management Unit Driver"
	depends on ARCH_MT6573
	default y

config MTK_FGADC # FGADC_MT6573
	tristate "MediaTek Fuel Gauge Driver"
	depends on ARCH_MT6573
	default y

config MTK_PMIC #
	tristate "MediaTek Power Management Unit Driver"
	default y

config MTK_PMIC_WRAP
	bool "MediaTek PMIC_WRAP driver "
	default y
	---help---
	  MediaTek pmic_wrap driver

config MTK_PMIC_RF2_26M_ALWAYS_ON
	bool "MediaTek PMIC RF@ 26M always on"
	default n

config POWER_EXT #
	tristate "MediaTek Power Ext"
	default y

config MTK_AUTO_POWER_ON_WITH_CHARGER
	bool "auto power on when charger in"
	default n

config MTK_SWCHR_SUPPORT #
	tristate "MediaTek switch charger"
	default y

config MTK_BQ24160_SUPPORT
	bool "MTK_BQ24160_SUPPORT"
	help
	  External switching charger

config MTK_BQ24196_SUPPORT
	bool "MediaTek Battery driver for TI BQ24196"
	help
	  BQ24196 charger IC support

config MTK_FAN5405_SUPPORT
	bool "MTK_FAN5405_SUPPORT"
	help
	  use external charger IC

config MTK_FAN5402_SUPPORT
	bool "MTK_FAN5402_SUPPORT"
	help
	  New Config BBK92 Drive Only Codebase

config MTK_BQ24158_SUPPORT
	bool "MTK_BQ24158_SUPPORT"
	help
	  add MTK_BQ24158_SUPPORT to ProjectConfig.mk default off

config MTK_BQ24296_SUPPORT
	bool "MTK_BQ24296_SUPPORT"
	help
	  BQ24296 charger IC support Yes to support bq24296 No to not
	  support bq24296

config MTK_BQ24297_SUPPORT
	bool "MTK_BQ24297_SUPPORT"
	help
	   add MTK_BQ24297_SUPPORT to ProjectConfig.mk default off

config MTK_BQ25890_SUPPORT
        bool "MTK_BQ25890_SUPPORT"
        help
           add MTK_BQ25890_SUPPORT to ProjectConfig.mk default off

config MTK_BQ27541_SUPPORT
	bool "MTK_BQ27541_SUPPORT"
	help
	  yes : support TI bq27541 external gauge IC

config MTK_NCP1851_SUPPORT
	bool "MTK_NCP1851_SUPPORT"
	help
	  Support NCP1851 external charger IC

config MTK_DISABLE_POWER_ON_OFF_VOLTAGE_LIMITATION
	bool "MTK_DISABLE_POWER_ON_OFF_VOLTAGE_LIMITATION"
	help

config MTK_KERNEL_POWER_OFF_CHARGING
	bool "MTK_KERNEL_POWER_OFF_CHARGING"
	help
	   yes : support KPOC feature, power off charging would running by
	   kernel and charging animation by IPO service. no: not support KPOC
	   feature, and power off charging would running by lk.

config MTK_BATTERY_PROTECT
	bool "MTK_BATTERY_PROTECT"

config MTK_BATTERY_THROTTLING
	bool "MTK_BATTERY_THROTTLING"

config MTK_ENABLE_AGING_ALGORITHM
	bool "Enable MediaTek Battery Aging Algorithm"

config MTK_BATTERY_LIFETIME_DATA_SUPPORT
	bool "Enable Battery LifeTime Data Logging"

config SOC_BY_EXT_HW_FG
	bool "Use external fuel gauge"
	default n

config SOC_BY_HW_FG
	bool "Use MediaTek H/W Fuel Gauge"
	default n

config SOC_BY_AUXADC
	bool "Only use AUXADC for Fuel Gauge"
	default n

config SOC_BY_SW_FG
	bool "Use MediaTek S/W Fuel Gauge"
	default n

config EXT_FG_HAS_SOC
	bool "External fuel gauge supports SOC report"
	default n

config EXT_FG_HAS_TEMPERATURE
	bool "External fuel gauge supports temperature report"
	default n

config SWCHR_POWER_PATH
	bool "External charger IC supports powerpath"
	default n

config CUST_DISABLE_CAPACITY_OCV2CV_TRANSFORM
	bool "Disable battery meter capacity OCV2CV transform"
	default n

config MTK_MULTI_BAT_PROFILE_SUPPORT
	bool "Multi-battery profile support"
	default n

config MTK_GET_BATTERY_ID_BY_AUXADC
	bool "Multi-battery profile support by auxadc"
	default n

config CUSTOM_BATTERY_CYCLE_AGING_DATA
	bool "Custom battery aging data is provided"
	default n

config MTK_JEITA_STANDARD_SUPPORT
	bool "JEITA standard support"
	default n

config BAT_LOW_TEMP_PROTECT_ENABLE
	bool "Disable charging when low temperature"
	default n

config STOP_CHARGING_IN_TAKLING
	bool "Hold charging in talking mode"
	default n

config CONFIG_DIS_CHECK_BATTERY
	bool "No shutdown if battery is not detected"
	default n

config CONFIG_USB_IF
	bool "USB IF support"
	default n

config HIGH_BATTERY_VOLTAGE_SUPPORT
	bool "Support battery above 4.3V"
	default n
endif #POWER_SUPPLY

config MTK_WIRELESS_CHARGER_SUPPORT
	bool "MTK_WIRELESS_CHARGER_SUPPORT"
	help
	  yes : support wireless charger feature, it can show the wireless
	  charging animation and charging icon when receive wireless charger
	  plug-in. no: not support wireless charger feature, stay with
	  legancy feature, which cannot sense the exist of the wireles
	  charger.
#
# add for power loss test
#
menuconfig PWR_LOSS_MTK_TEST
	tristate "Power Loss Test"
	default n
	help
	  Say Y here if you want do Power loss test for NAND Or EMMC
	  If unsure, say N.

if PWR_LOSS_MTK_TEST
config PWR_LOSS_MTK_DEBUG
	bool "Debugging"
	help
	  Say Y here if you want turns on low-level debugging
	  If unsure, say N.
endif

config MTK_THERMAL_PA_VIA_ATCMD
	bool "MTK_THERMAL_PA_VIA_ATCMD"
	help
	  Internal switch for thermal management to query modem RF
	  temperature via AT command.

endmenu
```

## drivers/misc/mediatek/Kconfig.storage
```kconfig
#
# All config related to storage(EMMC/SDCard/NAND/MTD/NVRAM...) goes here.
#

menu "Storage Drivers (EMMC/SDCard/NAND/MTD/NVRAM)"

config MTK_EMMC_SUPPORT
	bool "MTK_EMMC_SUPPORT"
	help
	   eMMC feature enable/disable

config MTK_SHARED_SDCARD
	bool "MTK_SHARED_SDCARD"
	help
	   sdcard will be a folder of /data

# Memory Card
config MTK_MMC # MMC_MT6516 MMC_MT6573
	tristate "MediaTek SD/MMC Card Interface support"
	---help---
	  This selects the MediaTek(R) Secure digital and Multimedia card Interface.
	  If you have a machine with a integrated SD/MMC card reader, say Y or M here.
	  If unsure, say N.

config MTK_NEW_COMBO_EMMC_SUPPORT
	bool "MTK_NEW_COMBO_EMMC_SUPPORT"
	help
	  Add option for new combo-emmc

config MTK_EMMC_SUPPORT_OTP
	tristate "MediaTek eMMC Card OTP support"
	---help---
	  This selects the MediaTek(R) eMMC Card OTP Support.
		  depends on MTK_MMC
		  default n

config MTK_SHARED_SDCARD
	bool "MTK_SHARED_SDCARD"
	default y

config MTK_MULTI_STORAGE_SUPPORT
	bool "MTK_MULTI_STORAGE_SUPPORT"
	help
	  Support more than 1 SD. Some write app can save to one of the
	  storages. Ex: Camera,recorder,browser,BT,ATV,CMMB.  Mount service
	  can mount multi-storage. And Media scanner will scan all storages.

config MTK_MULTI_PARTITION_MOUNT_ONLY_SUPPORT
	bool "MTK_MULTI_PARTITION_MOUNT_ONLY_SUPPORT"
	help
	  Enable/disable USB OTG to mount multi-partition USB disk

config MTK_EMMC_CACHE
	tristate "eMMC Cache"
	default n
	help
	  Say Y here if you want do enable cache feature for EMMC
	  If unsure, say N.

config MTK_GPT_SCHEME_SUPPORT
    bool "GUID partition table"
    default y
	help
	  Enable GPT in MSDC driver

config MTK_DUM_CHAR
	bool CONFIG_MTK_DUM_CHAR
	default n
	help
	  Enable character devices of partitions

# Nand
menuconfig MTK_MTD_NAND # MTD_NAND_MT6516
	tristate "MediaTek Nand Support"
	depends on MTD_NAND
	---help---
	  Enables support for NAND Flash chips wired to MediaTek chips.
config MTK_MTD_NAND_INTERRUPT_SCHEME # MTD_NAND_MT6516_INTERRUPT_SCHEME MTD_NAND_MT6573_INTERRUPT_SCHEME
	bool "Nand Read/Write with interrupt scheme"
	depends on MTK_MTD_NAND
	default n
	---help---
	  Enable interrupt scheme in Nand Read/Write.

config NAND_OTP_SUPPORT
	bool "NAND_OTP_SUPPORT"
	depends on MTK_MTD_NAND
	help
	   To simplify NAND OTP enable procedue.yes: Enable NAND OTP function
	   support,no: Disable NAND OTP function support

config MTK_COMBO_NAND_SUPPORT
	bool "MTK_COMBO_NAND_SUPPORT"
	depends on !MTK_EMMC_SUPPORT
	help
	  To support different NAND page size on the same load

endmenu
```

## drivers/misc/mediatek/lcm/Kconfig
```kconfig
#
#  Mediatek LCM driver support list
#

menu "Mediatek LCM driver support"

config HX8369_RGB_6585_FPGA
	bool "Support for LCM hx8369_rgb_6585_fpga"
	default n
	help
	    Select this if you are using "hx8369_rgb_6585_fpga"	

config CPT_CLAP070WP03XG_SN65DSI83
	bool "Support for LCM cpt_clap070wp03xg_sn65dsi83"
	default n
	help
	    Select this if you are using "cpt_clap070wp03xg_sn65dsi83"
			To config mt6595_tablet_p1v1 lcm driver. If choose yes
			cpt_clap070wp03xg_sn65dsi83 lcm driver will be used
			This add for half display issue
			
config NT35521_WXGA_DSI_VDO_HH060IA
	bool "Support for LCM nt35521_wxga_dsi_vdo_hh060ia"
	default n
	help
	    Select this if you are using "nt35521_wxga_dsi_vdo_hh060ia"
			To config mt6595_tablet_p1v1 lcm driver. If choose yes
			nt35521_wxga_dsi_vdo_hh060ia lcm driver will be used
			This add for half display issue

config CM_N070ICE_DSI_VDO_MT8135
	bool "Support for LCM cm_n070ice_dsi_vdo_mt8135"
	default n
	help
	    Select this if you are using "cm_n070ice_dsi_vdo_mt8135"
			To config mt8135_evbp1_v2 lcm driver. If choose yes
			cm_n070ice_dsi_vdo_mt8135 lcm driver will be used
			This add for half display issue			
			
config NT51012_WXGA_DSI_VDO
	bool "Support for LCM nt51012_wxga_dsi_vdo"
	default n
	help
	    Select this if you are using "nt51012_wxga_dsi_vdo"		

config R69429_WQXGA_DSI_VDO
	bool "Support for LCM r69429_wqxga_dsi_vdo"
	default n
	help
	    Select this if you are using "r69429_wqxga_dsi_vdo"
			To config mt8173_evb lcm driver. If choose yes
			r69429_wqxga_dsi_vdo lcm driver will be used
			This add for half display issue

config NT35595_FHD_DSI_CMD_TRULY_TPS65132
	bool "Support for LCM nt35595_fhd_dsi_cmd_truly_tps65132"
	default n
	help
	    Select this if you are using "nt35595_fhd_dsi_cmd_truly_tps65132"
			To config mt8173_evb lcm driver. If choose yes
			nt35595_fhd_dsi_cmd_truly_tps65132 lcm driver will be used
			This add for half display issue

config R69429_WQXGA_DSI_CMD
	bool "Support for LCM r69429_wqxga_dsi_cmd"
	default n
	help
	    Select this if you are using "r69429_wqxga_dsi_cmd"
			To config mt8173_evb lcm driver. If choose yes
			r69429_wqxga_dsi_vdo lcm driver will be used
			This add for half display issue
endmenu
```

## drivers/misc/mediatek/mach/mt8173/Kconfig
```kconfig
if ARCH_MT8173

comment "MT8173 boards support"

config TB8173_EVB
	bool "Support TB8173 EVB board"

config TB8173_P1
	bool "Support TB8173 P1 board"

config TB8173_BLOFELD
	bool "Support TB8173 Blofeld board"

config BX8173_P1
	bool "Support BX8173 P1 board"

config MAGNA
        bool "Support TB8173 MAGNA board"

config BX8173_P12
	bool "Support BX8173 P1V2 board"

config SLOANE
	bool "Sloane or blofeld TV/Box project"
endif
```

## drivers/misc/mediatek/systracker/Kconfig
```kconfig
config MTK_SYSTRACKER
	bool "Enable MTK System Tracker Debugger"
	default n
	help
	  SYSTRACKER is a hardware debugger to record timeout transaction and trigger SLV_ERR or interrupt to notify CPU.
	  Driver entry is located at /sys/bus/platform/drivers/systracker .
	  Use cat tracker_entry_dump to dump currect status.
	  The status will not be reset after watchdog reboot.
```

## drivers/net/wireless/mt66xx/Kconfig
```kconfig
menu "MediaTek WLAN Config"
config MTK_COMBO
	tristate "MediaTek Connectivity Combo Chip Support"
	default n
	help
	  MTK connectivity combo chip driver for MT66xx

#
# MTK Combo Chip Selection
#
choice
	prompt "Select Chip"
	depends on MTK_COMBO

config MTK_COMBO_CHIP_MT6620
	bool "MT6620"

config MTK_COMBO_CHIP_MT6628
	bool "MT6628"

config MTK_COMBO_CHIP_MT6630
	bool "MT6630"
	
endchoice
config MTK_COMBO_CHIP
	string
	default "MT6620" if MTK_COMBO_CHIP_MT6620
	default "MT6628" if MTK_COMBO_CHIP_MT6628
	default "MT6630" if MTK_COMBO_CHIP_MT6630
	help
	  this feature is used to identify combo chip version or SOC chip
	  consys version.
config MTK_WLAN_CHIP
	string "MTK_WLAN_CHIP"
	default "MT6620" if MTK_COMBO_CHIP_MT6620
	default "MT6628" if MTK_COMBO_CHIP_MT6628
	default "MT6630" if MTK_COMBO_CHIP_MT6630
	help
	  Define the wlan chip, the MTK_WLAN_SUPPORT must be set yes
config MTK_WLAN_SUPPORT
	bool "MTK_WLAN_SUPPORT"
	help
	  The Wlan switch for the wlan feature in the Android(app,
	  framework, native, kernel).

config MTK_WAPI_SUPPORT
	bool "MTK_WAPI_SUPPORT"
	depends on MTK_WLAN_SUPPORT
	help
	  if it is set to TRUE: Support WAPI (WLAN Authentication and
	  Privacy Infrastructure)

config MTK_PASSPOINT_R1_SUPPORT
	bool "MTK_PASSPOINT_R1_SUPPORT"
	help
	  Support Passpoint R1 (Hotspot 2.0 R1)

config MTK_PASSPOINT_R2_SUPPORT
	bool "MTK_PASSPOINT_R2_SUPPORT"
	help
	   Support Passpoint R2

config MTK_COMBO_WIFI
	tristate "MediaTek combo chip Wi-Fi support"
	depends on MTK_COMBO
	depends on !mt592x
	select WIRELESS_EXT
	select WEXT_PRIV

config MTK_DHCPV6C_WIFI
	bool "MTK_DHCPV6C_WIFI"
	help
	  no: disable this feature

config MTK_WFD_SUPPORT
	bool "MTK_WFD_SUPPORT"
	help
	  Wi-Fi Display Switch

endmenu
```

## drivers/pinctrl/mediatek/Kconfig
```kconfig
#if ARCH_MEDIATEK

config PINCTRL_MTK_COMMON
	bool
	select PINMUX
	select GENERIC_PINCONF
	select GPIOLIB

config PINCTRL_MT8173
	def_bool ARCH_MT8173
	select PINCTRL_MTK_COMMON

config PINCTRL_MT6397
	def_bool ARCH_MT8173 || ARCH_MT8135
	
#endif
```

## drivers/staging/amazon/Kconfig
```kconfig
menu "Amazon"

config AMAZON
	bool "Amazon Drivers"
	default N
	---help---
	  Enable support for various drivers needed on the Amazon Fire OS platform

if AMAZON

config AMAZON_KLOG_CONSOLE
	bool "Amazon Kernel Log Console"
	depends on ANDROID_LOGGER
	default N
	---help---
	  provide the kernel log console which will rewrite the kernel message to Android Logger buffer.

config AMAZON_SIGN_OF_LIFE
	bool "Amazon Sign of Life"
	help
          enable the life cycle metrics to log device boot and shutdown information

config AMAZON_SIGN_OF_LIFE_MTK
	bool "Amazon Sign of Life MTK platform implementation"
	help
          enable the life cycle metrics to log device boot and shutdown information on MTK Platform
endif # if AMAZON

endmenu
```

## sound/soc/mediatek/Kconfig
```kconfig
menuconfig SND_SOC_MT8135
    bool "SoC Audio support for MT8135"
    depends on ARCH_MT8135
    help
        If you say Y, enable SND_SOC_MT8135.

config SND_SOC_MT6595
    bool "SND_SOC_MT6595"
    depends on ARCH_MT6595
    default y
    help
        If you say Y, enable SND_SOC_MT6595 driver.

config SND_SOC_MT8173
    bool "SND_SOC_MT8173"
    depends on ARCH_MT8173
    default y
    help
        If you say Y, enable SND_SOC_MT8173 driver.

config MTK_SPEAKER
    bool "MTK_SPEAKER"
    depends on ARCH_MT6595
    default y
    help
        If you say Y, enable MTK_SPEAKER_AMP

if SND_SOC_MT8135
endif	# SND_SOC_MT8135

if SND_SOC_MT8173

source "sound/soc/mediatek/mt8173/Kconfig"

endif	# SND_SOC_MT8173
```

## sound/soc/mediatek/mt8173/Kconfig
```kconfig
choice
	prompt "MT8173 ASOC platform"

config SND_SOC_MT8173_GENERIC
	bool "MT8173 GENERIC"
	help
	  Say Y if you want to use the default
	  Mediatek SoC Audio interfaces for MT8173.
	  It is the generic solution.

config SND_SOC_MT8173_BLOFELD
	bool "MT8173 Blofeld"
	select SND_SOC_MAX97236
	help
	  Say Y if you want to use the Lab126 Blofeld
	  Audio interfaces for MT8173.
	  It will also add codec support of MAX97236

config SND_SOC_MT8173_SLOANE
	bool "MT8173 Sloane"
	help
	  Say Y if you want to use the Lab126 Sloane
	  Audio interfaces for MT8173.

endchoice
```
