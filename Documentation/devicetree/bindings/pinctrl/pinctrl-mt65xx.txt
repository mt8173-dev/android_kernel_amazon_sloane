## drivers/misc/mediatek/Kconfig.kernel
```kconfig
# TODO naming refine
menu "MTK Kernel Configurations (Debugging/Profiling/Scheduler/others...)"

config MTK_INTERNAL
	bool "Enable MTK internal debug feature"
	help
	  Identify if codebase is built with MTK internal debug
	  (Don't modify this feature option setting.)

config MTK_STAGING
	bool "Select which staging drivers you want"
	depends on SWAP
	select ZSMALLOC
	select ZRAM
	select ZRAM_DEBUG
	default n

config HAVE_AEE_FEATURE
	bool "HAVE_AEE_FEATURE"
	help
	  AEE (Android Exception Engine) that designed by  Mediatek is an
	  exception catching and debugging information generation mechanism.
	  It can collect and dump information to filesystem
	  (/sdcard/mtklog/aee_exp)  when fatel occur(E.g. kernel
	  panic/android system server crash and ..)

config HAVE_XLOG_FEATURE
	bool "HAVE_XLOG_FEATURE"
	help
	  It decide whether the system has XLOG mechanism. XLOG is a log
	  filter mechanism which can filter the logs by tag before they are
	  written to log buffer

config MTK_FORCE_CLUSTER1
	bool "MTK_FORCE_CLUSTER1"
	help
	  This option is used to forcing system to run on CPU cluster 1,
	  e.g. big cores on BIG.LITTLE system. MTK_FORCE_CLUSTER1 = "yes"
	  means enable this feature and "no" disable.

menu "MTK Cluster MultiProcessor Scheduler"
config MTK_SCHED_CMP
	bool "Enable CMP scheduler"
	depends on SMP && SCHED_MC
	default n
	help
	  Symmetric CMP Scheduler for MTK SoC.
	  Attempts to introspectively select tasks to optimize
	  energy and performance.
	  say no if not sure.

config MTK_SCHED_CMP_TGS
	bool "Enable thread group scheduling"
	depends on MTK_SCHED_CMP
	default n

config MTK_SCHED_CMP_TGS_WAKEUP
	bool "Enable thread group scheduling"
	depends on MTK_SCHED_CMP_TGS
	default n

config MTK_SCHED_CMP_PACK_SMALL_TASK
	bool "Packing small task"
	depends on MTK_SCHED_CMP && MTK_SCHED_CMP_TGS
	default n

config MTK_SCHED_CMP_LAZY_BALANCE
	bool "Enable CMP lazy balance"
	depends on MTK_SCHED_CMP_PACK_SMALL_TASK
	default n

config MTK_SCHED_CMP_POWER_AWARE_CONTROLLER
	bool "(EXPERIMENTAL) Power-aware Scheduler for MP Controller"
	depends on MTK_SCHED_CMP_PACK_SMALL_TASK && MTK_SCHED_CMP_LAZY_BALANCE
	help
		Power-aware scheduler for MP controller and status interface
endmenu


menu "MT load balance and schedule enhancement"
config MT_SCHED
	bool "Enhance CPU affinity in hotplug"
	depends on HOTPLUG

config MT_LOAD_BALANCE_ENHANCEMENT
	bool "mt load balance enhancement"
	depends on  SMP

config MT_LOAD_BALANCE_PROFILER
	bool "mt load balance profiler"
	depends on SCHEDSTATS && SMP

config MT_RT_SCHED_CRIT
	bool "mt RT scheduling critical log"

config MT_RT_SCHED
	bool "mt RT scheduling enhancement for big.LITTLE"
	depends on SCHED_HMP

config MT_RT_SCHED_LOG
	bool "mt RT scheduling enhancement for big.LITTLE"

config MT_SCHED_NOTICE
	bool "mt scheduling log, output important log into FTRACE, ftrace event: sched_log, default ENABLE"

config MT_SCHED_INFO
	bool "mt scheduling log, output detail flow info info FTRACE, ftrace event: sched_log"
	depends on MT_SCHED_NOTICE

config MT_SCHED_DEBUG
	bool "mt scheduling log, also output the scheduling log into Kernel log"
	depends on MT_SCHED_NOTICE

config MT_SCHED_DEBUG_ONLY
	bool "mt scheduler debug only"

endmenu


menu "Tracer Related"
config MTK_SCHED_TRACERS
	bool "MTK Sched Tracers"
	depends on TRACING
	select CONTEXT_SWITCH_TRACER
	default n
	help
	   Trace context swicth, set_scheduler, Interrupt Handler

config MTK_KERNEL_MARKER
	bool "MTK Kernel Marker API"
	depends on TRACING && KALLSYMS
	default n
	help
	  Mark the user-defined points, such as systrace events in
	  user space, to visualize via systrace html files

config FUNCTION_DURATION_TRACER
	bool "Kernel Function Duration Tracer"
	depends on FUNCTION_GRAPH_TRACER
	help
	  Enable the kernel to record function durations, with
	  filtering.  Can also be used in early startup.
	  See Documentation/trace/func-duration.txt

config MT65XX_TRACER
	bool "MT65XX Tracer"
	select CONTEXT_SWITCH_TRACER
	select GENERIC_TRACER
	default n

config GENERIC_TRACER
	bool "Scheduler Switch Tracer"

menu "MET"

config MTK_MET
	tristate "MET core driver"
	default n
	help
	  The core module of MTK MET profiling tool

config MTK_MET_PLF
	tristate "MET platform-related driver"
	depends on MTK_MET
	default n
	help
	  The platform module of MTK MET profiling tool

endmenu

endmenu


config MTPROF_CPUTIME
	bool "thread cputime profiling"
	depends on SCHEDSTATS

config MTPROF_IRQ_DURATION
	bool "mt IRQ/ISR profiling"

config MTK_AEE_FEATURE
	tristate "Enable Android Exception Enhancement"
	default n
	select FIQ_GLUE if !TRUSTONIC_TEE_SUPPORT
	---help---
	  Enable Android Exception Enhancement

config MTK_AEE_AED
	tristate "Enable AEE Kernel Exception Report Daemon"
	default y

config MTK_AEE_IPANIC
	tristate "Enable AEE Kernel Panic Dump"
	default y

config MTK_AEE_KDUMP
	tristate "Enable AEE KDUMP support"
	depends on ARCH_MT8135
	default y

config MTK_AEE_MRDUMP
	tristate "Enable AEE RAMDUMP support"
	depends on !ARCH_MT8135
	default y

config ANDROID_VMEM
	tristate "Virutally continuous memory allocator"
	default y

config CPUTIME_SUPPORT
	bool "cputime profiling support for functions"
	default n

config CPUTIME_STATS
	tristate "cputime profiling module for functions"
	select CPUTIME_SUPPORT
	default n

config MTK_RAM_CONSOLE
	bool "mt ram console"

config MTK_RAM_CONSOLE_USING_SRAM
	bool "Using SRAM as ram console storage"
	depends on MTK_RAM_CONSOLE

config MTK_RAM_CONSOLE_USING_DRAM
	bool "Using DRAM as ram console storage"
	depends on MTK_RAM_CONSOLE

config MTK_RAM_CONSOLE_SIZE
	hex "MTK RAM console  address"
	default 0
	depends on MTK_RAM_CONSOLE

config MTK_RAM_CONSOLE_ADDR
	hex "MTK RAM console buffer size"
	default 0
	depends on MTK_RAM_CONSOLE

config MTK_RAM_CONSOLE_DRAM_SIZE
	hex "MTK RAM console dram address"
	default 0
	depends on MTK_RAM_CONSOLE

config MTK_RAM_CONSOLE_DRAM_ADDR
	hex "MTK RAM console dram size"
	default 0
	depends on MTK_RAM_CONSOLE

config PREEMPT_MONITOR
	bool "mt preempt monitor"
	default n

config ISR_MONITOR
	bool "mt ISR monitor"
	default n

config MT_SCHED_MONITOR
	bool "mt scheduler monitor"
	default n

config MT_CHRDEV_REG
	bool "mt char driver number table"
	default n

config MT_LOCK_DEBUG
	bool "Record lock table and detect some possible deadlock"
	default n

config MT_DEBUG_MUTEXES
	bool "show mutex owner info"
	depends on DEBUG_MUTEXES
	default n

config PRINTK_PROCESS_INFO
	bool "Prefix pid/process_name to each kernel log"
	default n

config MT_ENG_BUILD
	bool "flag for MTK eng/usr build verification"
	default n

config RAMDISK_OFFSET
	hex "Uboot allocate memory offset for RAMDISK"
	default 0xF00000
	help
	Used to check decompressed kernel overwrite ramdisk.
	(DO NOT MODIFY IT YOURSELF.)

config MTK_MCI
	bool "Support For Memory coherence"
	default n
	help

config MTK_ETM
	bool "Support For Embedded Trace Macrocell"
	default y
	help

config MTK_MEMCFG
	bool "Support enhanced memory configurations"
	default n
	help

config MTK_CIRQ
	bool "Support For System CIRQ"
	default n
	help

config MTK_HIBERNATION
	bool "Support MTK hibernation"
	depends on HIBERNATION && PM_WAKELOCKS
	default y
	help

config MT_PRIO_TRACER
	bool "Record priority changes"
	default n
	help
	  Export device node under debugfs/prio_tracer

config MTK_WQ_DEBUG
	bool "mtk workqueue debug"
	default n

config MTK_SCHED_RQAVG_US
	bool "Enable runqueue staticsic calculation used in user space operation"
	depends on SMP
	default n
	help
	  TLP estimation for user space CPUfreq governors

config MTK_SCHED_RQAVG_KS
	bool "Enable runqueue staticsic calculation used in kernel space operation"
	depends on SMP
	default n
	help
	  TLP estimation for kernel space CPUfreq governors, e.g., hotplug

config MTK_STORAGE_PID_LOGGER
	bool "support MTK storage pid logger"
	default y

config MTK_LM_MODE
	bool "MTK Large Memory mode"
	select ARM_LPAE
	select ARCH_PHYS_ADDR_T_64BIT
	select ARCH_DMA_ADDR_T_64BIT
	help
	  Large Memory mode support for supporting more than 4GB DRAM access

config MTK_FAKE_MPIDR
	bool "Enable FAKE MPIDR"
	default n

config GATOR_DRIVER
	tristate "DS-5 profiling tool kernel driver"
	depends on GENERIC_TRACER && TRACING && PROFILING && HIGH_RES_TIMERS
	default n
	help
	  kernel driver of DS-5 profiling tool

config MTK_THERMAL_STATUS_COLLECTION
	bool "MTK Thermal Status Information Collection"
	default n

config MTK_MMPROFILE_SUPPORT
	bool "Multimedia profiling mechanism"

config MMPROFILE
	bool "MMProfile Support"
	help
	  deprecated, no one using this.

source "drivers/misc/mediatek/systracker/Kconfig"

endmenu
```

## drivers/misc/mediatek/Kconfig.media
```kconfig
#
# All config related to media(FB/audio/av codec/hdmi/mhl/wfd/GPU/camera...) goes here.
#

menu "Media Drivers (FB/AV codec/HDMI/MHL/WFD/GPU/Camera)"

config MTK_OVERLAY_ENGINE_SUPPORT
	bool "Enable MTK Overlay Engine Support"
	default n
	help
	  This enable MTK Video Path Overlay Engine Support.

# Frame Buffer Related
menuconfig MTK_FB # FB_MT6516 FB_MT6573
	bool "MediaTek Framebuffer Driver"
	depends on FB
	select FB_CFB_FILLRECT
	select FB_CFB_COPYAREA
	select FB_CFB_IMAGEBLIT
	select FB_SOFT_CURSOR
	---help---
	  This selects the MediaTek(R) frame buffer driver.
	  If you want to use MediaTek(R) frame buffer diver, say Y here.
	  If unsure, say N.

config MTK_FB_SUPPORT_ASSERTION_LAYER # FB_MT6516_SUPPORT_ASSERTION_LAYER
	bool "AEE Assertion Layer Support"
	depends on MTK_FB
	select FONT_8x16
	default y
	---help---
	  This enable support for AEE assertion layer.
	  If you want to enable AEE assertion layer support, say Y here.
	  If unsure, say N.

config ION_MTK
	bool "Mediatek ION Memory Manager"

config MTK_M4U_SUPPORT
	bool "MTK_M4U_SUPPORT"
	help
	   Used to enable or disable multimedia HW to access non-physical-
	   continuous memory. yes: multimedia HW can access non-physical-
	   continuous memory directly. no: multimedia HW can only access
	   physical continuous memory just like other common HW DMA.

# Graphics 2D
config MTK_G2D # MT6516_G2D
	bool "MediaTek G2D Driver"
	default y
	---help---
	  MT6516 G2D Driver

# RGX Config
config PVR_RGX_MT8135
	tristate "PowerVR RGX support"
	depends on ARCH_MT8135
	default m
	---help---
	  Enable this option to build support for the PowerVR RGX 3D core.

choice
	prompt "PowerVR build type"
	depends on PVR_RGX_MT8135
	default PVR_BUILD_RELEASE_MT8135

config PVR_BUILD_RELEASE_MT8135
	bool "Release"

config PVR_BUILD_DEBUG_MT8135
	bool "Debug"

endchoice

config MTK_GPU_CHIP
	string "MTK_GPU_CHIP"
	default "RGX_HAN" if PVR_RGX_MT8135
	help
	   This feature option is used to distinguish the version of GPU.
	   Different GPU has different shader compiler. We can use correctly
	   shader compiler to compiler our shaders by this option

config MTK_GPU_SUPPORT
	bool "MTK_GPU_SUPPORT"
	default y if PVR_RGX_MT8135
	help
	   MTK_GPU_SUPPORT=yes, means support HW GPU

# TODO check what's MT6516_EVB_BOARD
config MTK_FB_EVB_USE_HVGA_LCM # FB_MT6516_EVB_USE_HVGA_LCM
	bool "Use MagnaChip TA7601 HVGA LCM on EVB"
	depends on FB_MT6516 && MT6516_EVB_BOARD
	default n
	---help---
	  Use MagnaChip TA7601 HVGA LCM on EVB

config MTK_DITHERING_SUPPORT
	bool "MTK_DITHERING_SUPPORT"
	help
	  To control whether enable or disable LCD controller dithering
	  feature. If choose yes,  LCD controller would do dithering to
	  avoid contour effect, but side effect is that dithering mechanism
	  will make some noises

source "drivers/misc/mediatek/lcm/Kconfig"

config MTK_LCM_PHYSICAL_ROTATION
	string "MTK_LCM_PHYSICAL_ROTATION"
	help
	   To set the angle between dimension of UI layout and LCM scan
	   direction

config LCM_HEIGHT
	string "LCM_HEIGHT"
	default "1920"
	help
	  To set LCM resolution height size

config LCM_WIDTH
	string "LCM_WIDTH"
	default "1080"
	help
	  To set LCM resolution width size


comment "Codecs"

# Video Related
config MTK_MPEG4_DEC_DRIVER # MT6516_Mpeg4_Decoder_Driver
	tristate "MediaTek MPEG4 Decoder Driver"
	default y

config MTK_MPEG4_ENC_DRIVER # MT6516_Mpeg4_Encoder_Driver
	tristate "MediaTek MPEG4 Encoder Driver"
	default y

config MTK_H264_DEC_DRIVER # MT6516_H264_Decoder_Driver
	tristate "MediaTek H264 Decoder Driver"
	default y

config MTK_MFLEXVIDEO_DRIVER # MT6573_MFlexVideo_Driver
	tristate "MediaTek MFlexVideo Driver"
	default y

config MTK_VIDEOCODEC_DRIVER # MT6575_Video_Codec_Driver
	tristate "MediaTek VideoCodec Driver"
	default y

config MTK_VIDEO_HEVC_SUPPORT
	bool "MTK_VIDEO_HEVC_SUPPORT"
	help
	  This option is for HEVC playback/record feature

# Jpeg
config MTK_JPEG # JPEG_MT6516 (no JPEG_MT6573, but 6573 is supported!)
	tristate "MediaTek JPEG driver"
	default y


comment "HDMI/TVOut"

config MTK_TVOUT_SUPPORT
	bool "MTK_TVOUT_SUPPORT"
	help
	  To control whether enable or disable TV-out feature. If choose
	  yes, video or image on your phone can be demonstrated on TV via
	  TV-out cable. Also, this feature can help user to get more fun
	  when playing some games.

config MTK_MT8193_SUPPORT
	bool "MTK_MT8193_SUPPORT"

# HDMI
config MTK_HDMI_SUPPORT
	bool "MTK_HDMI_SUPPORT"
	help
	   To control whether enable or disable HDMI feature. If choose yes,
	   phone's screen can be demonstrated on TV via HDMI cable.

config MTK_MT8193_HDMI_SUPPORT
	bool "MTK_MT8193_HDMI_SUPPORT"
	depends on MTK_HDMI_SUPPORT
	depends on MTK_MT8193_SUPPORT

config MTK_MT8193_HDCP_SUPPORT
	bool "MTK_MT8193_HDCP_SUPPORT"
	help
	  Enable hdmi tx hdcp support

config MTK_INTERNAL_HDMI_SUPPORT
	bool "MTK_INTERNAL_HDMI_SUPPORT"
	depends on MTK_HDMI_SUPPORT
	help
	   To switch language set. Because some language need third party
	   font support, these language should be removed on custom project
	   first to avoid build error. It is no longer valid after
	   ALPS.GB.TDFD_MP.

config MTK_HDMI_HDCP_SUPPORT
	bool "MTK_HDMI_HDCP_SUPPORT"
	depends on MTK_HDMI_SUPPORT
	help
	   Enable hdmi tx hdcp support

config MTK_INTERNAL_MHL_SUPPORT
	bool "MTK_INTERNAL_MHL_SUPPORT"
	help
	   Enable internal mhl tx  support

config MTK_WFD_SUPPORT
	bool "MTK_WFD_SUPPORT"
	help
	   yes/no


comment "Camera"

config MTK_IMGSENSOR_HI253YUV_SUPPORT
	bool "hi253_yuv Image Sensor Driver"

config MTK_IMGSENSOR_HI704YUV_SUPPORT
	bool "hi704_yuv Image Sensor Driver"

config MTK_IMGSENSOR_HI704RAW_SUPPORT
	bool "hi704_raw Image Sensor Driver"

config MTK_IMGSENSOR_OV2722MIPIRAW_SUPPORT
	bool "ov2722_mipi_raw Image Sensor Driver"

config MTK_IMGSENSOR_OV2724MIPIRAW_SUPPORT
	bool "ov2724_mipi_raw Image Sensor Driver"

config MTK_IMGSENSOR_OV9724MIPIRAW_SUPPORT
	bool "ov9724_mipi_raw Image Sensor Driver"

config MTK_IMGSENSOR_IMX135MIPIRAW_SUPPORT
        bool "imx135_mipi_raw Image Sensor Driver"

config MTK_IMGSENSOR_OV5648MIPI_SUPPORT
        bool "ov5648_mipi_raw Image Sensor Driver"

config MTK_IMGSENSOR_S5K2P8MIPI_SUPPORT
        bool "s5k2p8_mipi_raw Image Sensor Driver"

config MTK_IMGSENSOR_S5K4ECGXMIPIYUV_SUPPORT
        bool "s5k4ecgx_mipi_yuv Image Sensor Driver"

config MTK_IMGSENSOR_OV2659YUV_SUPPORT
        bool "ov2659_yuv Image Sensor Driver"

config MTK_IMGSENSOR_S5K5E2YAMIPIRAW_SUPPORT
        bool "s5k5e2ya_mipi_raw Image Sensor Driver"

config MTK_EEPROM_DUMMYEEPROM_SUPPORT
	bool "Dummy EEPROM Driver"

config MTK_CAMCAL_DUMMYCAMCAL_SUPPORT
	bool "Dummy cam_cal Driver"

config MTK_FLASHLIGHT_DUMMYFLASHLIGHT_SUPPORT
	bool "Dummy Flashlight Driver"

config MTK_FLASHLIGHT_CONSTANTFLASHLIGHT_SUPPORT
	bool "Constant Flashlight Driver"
	help
		set yes to eanble Flashlight driver

config MTK_LENS_DUMMYLENS_SUPPORT
	bool "Dummy Lens Driver"

config MTK_LENS_DW9718AF_SUPPORT
	bool "DW9718AF Lens Driver"
	help
		set yes to enable AF lens driver: dw9718af

endmenu
```
