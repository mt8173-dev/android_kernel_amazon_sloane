## Documentation/devicetree/bindings/pinctrl/pinctrl-mt65xx.txt
```
* Mediatek MT65XX Pin Controller

The Mediatek's Pin controller is used to control GPIO pins.

Required properties:
- compatible: value should be either of the following.
    (a) "mediatek,mt8135-pinctrl", compatible with mt8135 pinctrl.
- reg: Should contain the register physical address and length for the
  pin controller.
- gpio-controller : Marks the device node as a gpio controller.
- #gpio-cells: number of cells in GPIO specifier. Since the generic GPIO
  binding is used, the amount of cells must be specified as 2. See the below
  mentioned gpio binding representation for description of particular cells.

	Eg: <&pio 6 0>
	<[phandle of the gpio controller node]
	[pin number within the gpio controller]
	[flags]>

	Values for gpio specifier:
	- Pin number: is a value between 0 to 202.
	- Flags:  bit field of flags, as defined in <dt-bindings/gpio/gpio.h>.
            Only the following flags are supported:
            0 - GPIO_ACTIVE_HIGH
            1 - GPIO_ACTIVE_LOW

Please refer to pinctrl-bindings.txt in this directory for details of the
common pinctrl bindings used by client devices.

A pinctrl node should contain at least one subnodes representing the
pinctrl groups available on the machine. Each subnode will list the
pins it needs, and how they should be configured, with regard to muxer
configuration, pullups, drive strngth, input enable/disable and input schmitt.

Required subnode-properties:

- mediatek,pins: 2 integers array, represents gpio pinmux number and config
    setting. The format is mediatek,pins = <PIN_NUMBER_PINMUX &phandle>.
    The PIN_NUMBER_PINMUX is combination of GPIO number and pinmux, it can
    use macros which already defind in boot/dts/mt8135-pinfunc.h directly.
    The phandle of a node containing the generic pinconfig options
    to use, bias-disable, bias-pull-down, bias-pull-up, input-enable,
    input-disable, output-low, output-high, input-schmitt-enable, input-schmitt-disable
    and drive-strength are valid.

    When config bias-pull-up, some pins have the internal pull-up resistors,
    user can choose to use R0, R1 or R0R1.

    When config drive-strength, User can set the driving current from 2mA to 32mA,
    some macros have already defined in dt-bindings/pinctrl/mt65xx.h.

Examples:

#include <dt-bindings/pinctrl/mt65xx.h>
#include "mt8135-pinfunc.h"

...

pinctrl@01c20800 {
	compatible = "mediatek,mt8135-pinctrl";
	reg = <0 0x10005000 0 0x1000>;
	gpio-controller;
	#gpio-cells = <2>;

	pcfg_pull_down: pcfg_pull_down {
		bias-pull-down;
	};

	pcfg_pull_up: pcfg_pull_up {
		bias-pull-up = <MTK_PUPD_SET_R0_10>;
	};

	pcfg_i2c_cfgs: pcfg_i2c_cfgs {
		bias-disable;
		drive-strength = <MTK_DRIVE_6mA>;
		input-schmitt-enable;
		...
	};

	pcfg_output_high: pcfg_output_high {
		output-high;
	};

	i2c0_pins_a: i2c0@0 {
		mediatek,pins = <MT8135_PIN_100_SDA0__FUNC_SDA0 &pcfg_pull_none>,
				<MT8135_PIN_101_SCL0__FUNC_SCL0 &pcfg_pull_none>;
	};

	i2c1_pins_a: i2c1@0 {
		mediatek,pins = <MT8135_PIN_195_SDA1__FUNC_SDA1 &pcfg_pull_up>,
				<MT8135_PIN_196_SCL1__FUNC_SCL1 &pcfg_pull_up>;
	};

	i2c2_pins_a: i2c2@0
		mediatek,pins = <MT8135_PIN_193_SDA2__FUNC_SDA2 &pcfg_i2c_cfgs>,
				<MT8135_PIN_194_SCL2__FUNC_SCL2 &pcfg_i2c_cfgs>;
	};

	i2c3_pins_a: i2c3@0 {
		mediatek,pins = <MT8135_PIN_35_SCL3__FUNC_SCL3 &pcfg_output_low>,
				<MT8135_PIN_36_SDA3__FUNC_SDA3 &pcfg_output_low>;
	};

	...

};
```

## Documentation/devicetree/bindings/regulator/mt6397-regulator.txt
```
Mediatek mt6397 regulator

Required properties:
- compatible: "mediatek,mt6397"
- regulators: This is the list of child nodes that specify the regulator
  initialization data for defined regulators. The definition for each of these
  nodes is defined using the standard binding for regulators found at
  Documentation/devicetree/bindings/regulator/regulator.txt.

Example:

	pmic {
		compatible = "mediatek,mt6397";

		regulators {

			mt6397_vpca15_reg: buck_vpca15 {
				regulator-name = "vpca15";
				regulator-min-microvolt = < 700000>;
				regulator-max-microvolt = <1493750>;
				regulator-always-on;
				regulator-boot-on;
			};

			mt6397_vgp4_reg: ldo_vgp4 {
				regulator-name = "vgp4";
				regulator-min-microvolt = <1200000>;
				regulator-max-microvolt = <3300000>;
			};
		};
	};
```

## drivers/misc/mediatek/Kconfig
```kconfig
menuconfig MEDIATEK_SOLUTION
	bool "MediaTek Properitary Configuration"
	help
	  Check this to enable MediaTek properity configuration.

if MEDIATEK_SOLUTION

config MTK_PLATFORM
	string "MTK platform name"
	default "mt8135" if ARCH_MT8135
	default "mt6582" if ARCH_MT6582
	default "mt6595" if ARCH_MT6595

config ARCH_MTK_PROJECT
	string "MTK project name"

config FPGA_EARLY_PORTING
	bool "FPGA_EARLY_PORTING"
	help
	  Used for FPGA early porting to separate code segments between FPGA
	  platform and non-FPGA platform

config MTK_TC1_FEATURE
	bool "MTK_TC1_FEATURE"
	default n

#
# Security related feature
#

config HAVE_MTK_IN_HOUSE_TEE_SUPPORT
	def_bool n

config MTK_IN_HOUSE_TEE_SUPPORT
	bool "Enable MTK In House TEE Support"
	depends on HAVE_MTK_IN_HOUSE_TEE_SUPPORT
	default n
	help
	  This enable MTK TEE support.

config HAVE_TRUSTONIC_TEE_SUPPORT
	def_bool n

#
# TRUSTONIC TEE configuration
#
config TRUSTONIC_TEE_SUPPORT
	bool "Enable Trustonic TEE Support"
	depends on HAVE_TRUSTONIC_TEE_SUPPORT
	default n
	---help---
	  Enable Trustonic TEE Support

#
# MobiCore configuration
#
config MOBICORE_DRIVER
	tristate "MobiCore Driver"
	depends on TRUSTONIC_TEE_SUPPORT
	default n
	---help---
	  Enable Linux Kernel MobiCore Support

config MOBICORE_DEBUG
	bool "MobiCore Module debug mode"
	depends on MOBICORE_DRIVER
	default n
	---help---
	  Enable Debug mode in the MobiCore Driver.
	  It enables printing information about mobicore operations

config MOBICORE_VERBOSE
	bool "MobiCore Module verbose debug mode"
	depends on MOBICORE_DEBUG
	default n
	---help---
	  Enable Verbose Debug mode in the MobiCore Driver.
	  It enables printing extra information about mobicore operations
	  Beware: this is only useful for debuging deep in the driver because
	  it prints too much logs

config MOBICORE_API
	tristate "Linux MobiCore API"
	depends on MOBICORE_DRIVER
	default n
	---help---
	  Enable Linux Kernel MobiCore API

config MTK_SEC_VIDEO_PATH_SUPPORT
	bool "Enable MTK Secure Video Path Support"
	depends on (MTK_IN_HOUSE_TEE_SUPPORT) || (TRUSTONIC_TEE_SUPPORT)
	default n
	help
	  This enable MTK Secure Video Path Support. (depending on MTK In-House TEE Support or Trustonic TEE Support)

config MTK_SEC_WFD_VIDEO_PATH_SUPPORT
	bool "Enable MTK Secure WFD Video Path Support"
	depends on MTK_SEC_VIDEO_PATH_SUPPORT
	depends on MTK_IN_HOUSE_TEE_SUPPORT
	default n
	help
	  This enable MTK WFD Secure Video Path Support.

config MTK_SEC_HDMI_VIDEO_PATH_SUPPORT
	bool "Enable MTK Secure HDMI Video Path Support"
	depends on MTK_SEC_VIDEO_PATH_SUPPORT
	depends on MTK_IN_HOUSE_TEE_SUPPORT
	default n
	help
	  This enable MTK HDMI Secure Video Path Support.

config MTK_DRM_KEY_MNG_SUPPORT
	bool "MTK_DRM_KEY_MNG_SUPPORT"
	depends on MTK_IN_HOUSE_TEE_SUPPORT
	default n
	help
	   support MTK DRM Key Management

config MTK_SECURITY_SW_SUPPORT
	bool "MTK_SECURITY_SW_SUPPORT"
	help
	   MTK_SECURITY_SW_SUPPORT=yes==> All security function in pre-
	   loader/LK/kernel/android will be built into software images

config MTK_SEC_MODEM_NVRAM_ANTI_CLONE
	bool "MTK_SEC_MODEM_NVRAM_ANTI_CLONE"
	help
	  This option is used to enable modem NVRAM anti-clone functionality
	  [dependency_relationship]: yes If this option is turned on, the
	  modem part should also turn on for the following setting 1. Modem
	  project file CUSTOM_OPTION += __NVRAM_BIND_TO_CHIP_CIPHER__ 2. by
	  default, only two LID is defaulted has MSP attribute
	  (1)NVRAM_EF_SML_LID (2)NVRAM_EF_SIM_LOCK_LID 3. if want to turn on
	  specific LID, please add attribute NVRAM_ATTR_MSP

# Custom
menu "Mediatek CUSTOM Settings"
config CUSTOM_KERNEL_ACCELEROMETER
	bool "CUSTOM_KERNEL_ACCELEROMETER"
	help
	  accelerometer sensor to detect accelerometer from x y z axis.

config CUSTOM_KERNEL_BAROMETER
	bool "CUSTOM_KERNEL_BAROMETER"
	help
	  Pressure sensor driver to detect pressure

config CUSTOM_KERNEL_ALSPS
	bool "CUSTOM_KERNEL_ALSPS"
	help
	  ALSPS sensor driverto detect ambint light and the object is close
	  or far awary from device

config CUSTOM_KERNEL_EXTMD
	string "CUSTOM_KERNEL_EXTMD"

config CUSTOM_KERNEL_FLASHLIGHT
	string "CUSTOM_KERNEL_FLASHLIGHT"
	help
	   Kernel space cameara flashlight driver. You can use this driver
	   choose cameara flashlight type.

config CUSTOM_KERNEL_GYROSCOPE
	bool "CUSTOM_KERNEL_GYROSCOPE"
	help
	   gyro driver

config CUSTOM_KERNEL_HDMI
	string "CUSTOM_KERNEL_HDMI"
	help
	   Specify HDMI external IC type.

config CUSTOM_KERNEL_IMGSENSOR
	string "CUSTOM_KERNEL_IMGSENSOR"
	help
	  Kernel space image sensor driver. Define  project used all image
	  sensors .The value is combination of CUSTOM_KERNEL_MAIN_IMGSENSOR,
	  CUSTOM_KERNEL_MAIN_BACKUP_IMGSENSOR, CUSTOM_KERNEL_SUB_IMGSENSOR,
	  and CUSTOM_KERNEL_SUB_BACKUP_IMGSENSOR

config CUSTOM_KERNEL_LCM
	string "CUSTOM_KERNEL_LCM"
	help
	  To choose kernel LCM driver name

config CUSTOM_KERNEL_MAGNETOMETER
	bool "CUSTOM_KERNEL_MAGNETOMETER"
	help
	   compass driver to detect compass raw data and report orientatino
	   data

config CUSTOM_KERNEL_OFN
	bool "CUSTOM_KERNEL_OFN"

config CUSTOM_KERNEL_TOUCHPANEL
	string "CUSTOM_KERNEL_TOUCHPANEL"
	help
	   touch driver  need to report correct touch axes

config CUSTOM_SEC_AUTH_SUPPORT
	bool "CUSTOM_SEC_AUTH_SUPPORT"
	help
	   Support customer to implement and apply their own RSA security
	   functions

config CUSTOM_KERNEL_SSW
	bool "CUSTOM_KERNEL_SSW"
	help
	  sim switch hardware

config MTK_ALPS_BOX_SUPPORT
	bool "MTK_ALPS_BOX_SUPPORT"
	default n
	help
	  This enable MTK HDMI Main Path Support.

config MT8173_BOX_SUPPORT
	bool "MT8173_BOX_SUPPORT"
	default n
	help
	  Support MT8173 box.

config MTK_CMDQ_TEST_PROC
	bool "MTK_CMDQ_TEST_PROC"
	default n
	help
	  Support cmdq proc test
endmenu

source "drivers/misc/mediatek/Kconfig.kernel"
source "drivers/misc/mediatek/Kconfig.connect"
source "drivers/misc/mediatek/Kconfig.media"
source "drivers/misc/mediatek/Kconfig.power"
source "drivers/misc/mediatek/Kconfig.storage"
source "drivers/misc/mediatek/Kconfig.drivers"

endif
```
