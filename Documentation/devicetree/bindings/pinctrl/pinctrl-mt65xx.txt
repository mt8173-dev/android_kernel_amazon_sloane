## drivers/misc/mediatek/Kconfig.connect
```kconfig
#
# All config related to connectivity(Wifi/GPS/NFC/BT/FM...) goes here.
#

menu "Connectivity (Wifi/GPS/NFC/BT/FM)"

config MTK_DT_SUPPORT
	bool "MTK_DT_SUPPORT"
	help
	   support dual talk

config EVDO_DT_SUPPORT
	bool "EVDO_DT_SUPPORT"
	help
	   To support GSM+CDMA dual talk feature


# CCCI TODO refine
menuconfig MTK_CCCI_DEVICES # CCCI_DEVICES TODO Depends on ARCH_MT6573 --> no body use it, should be delete?
	bool "CCCI Devices"
	default n
	---help---
	  Say Y here to get to see options for device drivers from ccci.
	  If you say N, all options in this submenu will be skipped and disabled.

config MTK_CCCI_DRIVER # CCCI_DRIVER
	tristate "CCCI Driver"
	depends on MTK_CCCI_DEVICES
	default m
	---help---
	  This option enables ccci device driver support

config MTK_CCCI_EXT # CCCI_DRIVER
	tristate "Dual CCCI Driver"
	depends on MTK_CCCI_DEVICES
	default y
	---help---
	  This option enables dual ccci device driver support

config MTK_ECCCI_DRIVER
	tristate "ECCCI Driver"
	default n
	---help---
	  This option enables ECCCI device driver support

config MTK_ECCCI_UT
	tristate "ECCCI UT mode"
	depends on MTK_ECCCI_DRIVER
	default n
	---help---
	  This option enables ECCCI UT mode (software loopback, no CLDMA support)

config MTK_NET_CCMNI # NET_CCMNI
	bool "MediaTek CCMNI driver"
	depends on MTK_CCCI_DEVICES
	default n
	select WIRELESS_EXT
	select WEXT_PRIV

config MTK_DSPIRDBG
	bool "MTK_DSPIRDBG"
	help
	   Control the DSPIRDBG, which is used to control the log output. Its
	   dafault value is no, would be set to yes by RD when needed. It's
	   depend on MDLogger.

config MTK_SEC_MODEM_NVRAM_ANTI_CLONE
	bool "MTK_SEC_MODEM_NVRAM_ANTI_CLONE"
	help
	   yes ==> Enable MODEM NVRAM anti-clone

config PURE_AP_USE_EXTERNAL_MODEM
	bool "PURE_AP_USE_EXTERNAL_MODEM"
	help
	   AP only chip use external modem

config MTK_EXTERNAL_MODEM_SLOT
	string "MTK_EXTERNAL_MODEM_SLOT"

config MTK_ENABLE_MD1
	bool "MTK_ENABLE_MD1"
	help
	   Set to yes, if the first modem is enabled

config MTK_ENABLE_MD2
	bool "MTK_ENABLE_MD2"
	help
	   Set to yes, if the second modem is enabled

config MD1_SMEM_SIZE
	string "MD1_SMEM_SIZE"
	help
	   modem 1 share memory size.

config MD2_SMEM_SIZE
	string "MD2_SMEM_SIZE"
	help
	   modem 2 share memory size.



menuconfig GPS
	tristate "GPS drivers"
	default y
	---help---
	  Say Y here for supporting GPS.

if GPS
config MTK_GPS # MT6516_GPS --> TODO should change to use modulized settings!
	tristate "MediaTek 3326 GPS driver"
	default y
	---help---
	  MT3326 GPS driver
endif # GPS


menuconfig MTK_NFC
	tristate "NFC drivers"
	default n
	---help---
	  Say Y here for supporting NFC.

if MTK_NFC

config NFC_MT6605
	tristate "MediaTek NFC driver"
	default n

config NFC_MSR3110
	tristate "MSR3110 NFC driver"
	default n

endif # NFC

config MTK_BTIF
	tristate"MediaTek BTIF Driver"

config MTK_BT_SUPPORT
	bool "MTK_BT_SUPPORT"
	help
	   When this option set to yes, the MTK Bluetooth solution will be
	   included.

config MTK_NFC_SUPPORT
	bool "MTK_NFC_SUPPORT"
	help
	   NFC stands for near field communication. It is a short-range
	   wireless communication technology, which can be used in data
	   exchange, information download, payment application, etc


config MTK_COMBO
	tristate "MediaTek Connectivity Combo Chip Support"
	default n
	help
	  MTK connectivity combo chip driver for MT66xx

#
# MTK Combo Chip Selection
#
choice
	prompt "Select Chip"
	depends on MTK_COMBO

config MTK_COMBO_CHIP_MT6620
	bool "MT6620"

config MTK_COMBO_CHIP_MT6628
	bool "MT6628"

config MTK_COMBO_CHIP_MT6630
	bool "MT6630"

config MTK_COMBO_CHIP_MT7662
	bool "MT7662"
	select WIRELESS_EXT
	select WEXT_PRIV
endchoice
config MTK_COMBO_CHIP
	string
	default "MT6620" if MTK_COMBO_CHIP_MT6620
	default "MT6628" if MTK_COMBO_CHIP_MT6628
	default "MT6630" if MTK_COMBO_CHIP_MT6630
	help
	  this feature is used to identify combo chip version or SOC chip
	  consys version.
config MTK_WLAN_CHIP
	string "MTK_WLAN_CHIP"
	default "MT6620" if MTK_COMBO_CHIP_MT6620
	default "MT6628" if MTK_COMBO_CHIP_MT6628
	default "MT6630" if MTK_COMBO_CHIP_MT6630
	help
	  Define the wlan chip, the MTK_WLAN_SUPPORT must be set yes
config MTK_WLAN_SUPPORT
	bool "MTK_WLAN_SUPPORT"
	help
	  The Wlan switch for the wlan feature in the Android(app,
	  framework, native, kernel).

config MTK_WAPI_SUPPORT
	bool "MTK_WAPI_SUPPORT"
	depends on MTK_WLAN_SUPPORT
	help
	  if it is set to TRUE: Support WAPI (WLAN Authentication and
	  Privacy Infrastructure)

#
# Target Platform Selection
#
config MTK_COMBO_PLAT_PATH
	string "Platform folder name"
	depends on MTK_COMBO
	default "sample" if MTK_COMBO_PLAT_SAMPLE
	help
	  Specify platform folder under common driver platform folder:
	  mtk_wcn_combo/common/platform/*

#
# MTK COMBO Chip Configuration
#
config MTK_COMBO_COMM
	depends on MTK_COMBO
	tristate "MediaTek Combo Chip Common part driver"
	help
	  MediaTek combo chip common part driver

#config MTK_COMBO_COMM_PS
#	depends on MTK_COMBO_COMM
#	bool "Enable PS support"
#	default n
#	help
#	  Enable PS support of common UART interface

config MTK_COMBO_COMM_UART
	depends on MTK_COMBO_COMM
	tristate "Common interface UART"
	help
	  Use UART for common part interface type

config MTK_COMBO_COMM_SDIO
	depends on MTK_COMBO_COMM
	tristate "Common interface SDIO"
	help
	  Use SDIO for common part interface type

config MTK_COMBO_BT
	tristate "MediaTek Combo Chip BT driver"
	depends on MTK_COMBO
	help
	  MTK BT /dev/stpbt driver for Bluedroid (mtk_stp_bt.ko)

config MTK_COMBO_BT_HCI
	tristate "MediaTek Combo Chip BlueZ driver"
	depends on BT && MTK_COMBO
	help
	  MTK BT driver for BlueZ (hci_stp.ko)

config MTK_COMBO_GPS
	tristate "MediaTek Combo Chip GPS driver"
	depends on MTK_COMBO
	help
	  MTK GPS /dev/stpgps driver (mtk_stp_gps.ko)

config MTK_GPS_SUPPORT
	tristate "MediaTek GPS driver"
	select MTK_GPS
	help
	  to switch GPS feature on the platform. Set "yes" to turn
	  on and set "no"(with MTK_AGPS_APP=no at the same time) to turn
	  off.

config MTK_COMBO_PSM_RX_TH
	string "MTK_COMBO_PSM_RX_TH"
	depends on MTK_COMBO

config MTK_COMBO_PSM_TX_TH
	string "MTK_COMBO_PSM_TX_TH"
	depends on MTK_COMBO

config MTK_PASSPOINT_R1_SUPPORT
	bool "MTK_PASSPOINT_R1_SUPPORT"
	help
	  Support Passpoint R1 (Hotspot 2.0 R1)

config MTK_PASSPOINT_R2_SUPPORT
	bool "MTK_PASSPOINT_R2_SUPPORT"
	help
	   Support Passpoint R2

config MTK_COMBO_WIFI
	tristate "MediaTek combo chip Wi-Fi support"
	depends on MTK_COMBO
	depends on !mt592x
	select WIRELESS_EXT
	select WEXT_PRIV

config MTK_DHCPV6C_WIFI
	bool "MTK_DHCPV6C_WIFI"
	help
	  no: disable this feature

config MTK_WFD_SUPPORT
	bool "MTK_WFD_SUPPORT"
	help
	  Wi-Fi Display Switch


config MTK_MERGE_INTERFACE_SUPPORT
	bool "MTK_MERGE_INTERFACE_SUPPORT"
	help
	   mergeinterface setting between 6628 and 6589

config MTK_FM
	bool "MediaTek FM Chip Support"
	default n

config MTK_FM_SUPPORT
	bool "MTK_FM_SUPPORT"
	help
	  The root switch of Android FM, if  "no", all features(RX&TX) of FM
	  will be removed from android system

config MTK_FM_50KHZ_SUPPORT
	bool "MTK_FM_50KHZ_SUPPORT"
	depends on MTK_FM_SUPPORT
	help
	  The feature option is to define if we support FM 50KHz step
	  tune/seek/scan functions

config MTK_FM_RX_AUDIO
	string "define FM TX type digital or analog"
	depends on MTK_FM_SUPPORT
	help
	   "FM_DIGITAL_INPUT" for digital input
	   "FM_ANALOG_INPUT" for analog input

config MTK_MERGE_INTERFACE_SUPPORT
	bool "MTK_MERGE_INTERFACE_SUPPORT"

config SDIOAUTOK_SUPPORT
	tristate "MediaTek SDIO UHS auto calibration support"
	default n

# CMMB
config  MTK_CMMB
	tristate "MediaTek CMMB Driver"
	depends on  MTK_SPI
	default m
	---help---
	  This selects the MediaTek(R) CMMB driver.
	  If you want to use MediaTek(R) CMMB driver, say M here.
	  If unsure, say N.

config HAVE_CMMB_FEATURE
	bool "HAVE_CMMB_FEATURE"
	help
	   cmmb feature compile option, if set yes, cmmb can build in load .

config MTK_CMMB_CHIP
	string "MTK_CMMB_CHIP"
	help
	   cmmb chip name

# SIM2 # TODO Driver like this, add depends on ARCH_MT6516
config MTK_SIM2 # MT6516_SIM2
	bool "MediaTek SIM2 Driver"
	default y

config MTK_UMTS_TDD128_MODE
	bool "MTK_UMTS_TDD128_MODE"
	help
	  MTK_UMTS_TDD128_MODE=yes means enable UMTS TDD128 specific
	  features MTK_UMTS_TDD128_MODE=no means disable UMTS TDD128
	  specific features.  This feature option is used for APP to
	  distinguish TDD, e.g. TDD modem, TDD HW,
	  TDD specific customization, etc. TDD projects need to enable this
	  feature option, non-TDD projects must disable this feature option.

config MTK_SIM1_SOCKET_TYPE
	string "MTK_SIM1_SOCKET_TYPE"
	help
	   description =MTK_SIM1_SOCKET_TYPE=1: support type 1 socket type

config MTK_SIM2_SOCKET_TYPE
	string "MTK_SIM2_SOCKET_TYPE"
	help
	   description =MTK_SIM1_SOCKET_TYPE=1: support type 1 socket type

# Wireless
menuconfig MT592X
	tristate "MediaTek MT592x driver support"
	depends on MTK_COMBO_WIFI=n
	select WIRELESS_EXT
	select WEXT_PRIV

config MT5921
	bool "MediaTek MT5921 WLAN card"
	depends on MT592X

config MT5922
	bool "MediaTek MT5922 WLAN card"
	depends on MT592X

config MT592X_DEBUG
	bool "MediaTek MT592x debug support"
	depends on MT592X

config MT592X_PROC
	bool "MediaTek MT592x proc support"
	depends on MT592X

config MT592X_IBSS
	bool "MediaTek MT592x IBSS support"
	depends on MT592X

config MT592X_SW_ENC
	bool "MediaTek MT592x software encrypt support"
	depends on MT592X

config MT592X_WPS
	bool "MediaTek MT592x WPS support"
	depends on MT592X

config MT592X_EEPROM
	bool "MediaTek MT592x EEPROM support"
	depends on MT592X

config MT592X_WAPI
	bool "MediaTek MT592x WAPI support"
	depends on MT592X

config MT592X_PTA
	bool "MediaTek MT592x PTA support"
	depends on MT592X

config MT592X_SDIO
	bool "MediaTek MT592x SDIO support"
	depends on MT592X && MMC

config MT592X_SDIO_CLNT
	tristate "MediaTek MT592X SDIO CLNT support"
	depends on MMC

endmenu
```
